## firmware/main/Kconfig.projbuild
```kconfig
menu "RobotBuddy Configuration"

    config ROBOTBUDDY_FIRMWARE_VERSION
        string "Firmware Version"
        default "0.1.0-dev"
        help
            Current firmware version string (SemVer format).
            Updated by /release command.

    config ROBOTBUDDY_HARDWARE_VERSION
        string "Hardware Version"
        default "V1.0"
        help
            Hardware version identifier.
            V1.0 = ESP32-S3-WROOM-1-N16R8 + ST7789 + INMP441 + MAX98357A

    config ROBOTBUDDY_DEBUG_ENABLE
        bool "Enable debug logging"
        default y
        help
            Enable verbose debug logging for all RobotBuddy modules.
            Disable for production to reduce flash and RAM usage.

    config ROBOTBUDDY_WIFI_SSID
        string "Default WiFi SSID"
        default "RobotBuddy_Setup"
        help
            Default WiFi SSID for initial configuration.
            Will be overwritten by provisioning process.

    config ROBOTBUDDY_AUDIO_SAMPLE_RATE
        int "Audio Sample Rate (Hz)"
        default 16000
        help
            Audio sample rate in Hz. Supported: 8000, 16000, 22050, 44100, 48000.
            RobotBuddy uses 16000 Hz for voice interaction.

    config ROBOTBUDDY_DISPLAY_FPS
        int "Display Refresh Rate (FPS)"
        default 30
        range 10 60
        help
            Target display refresh rate in frames per second.
            Higher values require more CPU and SPI bandwidth.

    config ROBOTBUDDY_MOTION_CONTROL_HZ
        int "Motor Control Rate (Hz)"
        default 100
        range 50 200
        help
            Motor PID control loop frequency in Hz.
            100 Hz is recommended for N20 motors with DRV8833.

endmenu
```

## firmware/sdkconfig.defaults
```kconfig
# RobotBuddy ESP32-S3 Default Configuration
# ============================================
# Target: ESP32-S3-WROOM-1-N16R8 (16MB Flash, 8MB PSRAM)
# Apply with: idf.py set-target esp32s3 && idf.py build

# Target chip
CONFIG_IDF_TARGET="esp32s3"

# CPU frequency
CONFIG_ESP32S3_DEFAULT_CPU_FREQ_240=y
CONFIG_ESP32S3_DEFAULT_CPU_FREQ_MHZ=240

# Flash configuration (16MB)
CONFIG_ESPTOOLPY_FLASHSIZE_16MB=y
CONFIG_ESPTOOLPY_FLASHSIZE="16MB"
CONFIG_ESPTOOLPY_FLASHMODE_QIO=y
CONFIG_ESPTOOLPY_FLASHFREQ_80M=y

# PSRAM configuration (8MB OCTAL)
CONFIG_ESP32S3_SPIRAM_SUPPORT=y
CONFIG_SPIRAM_MODE_OCT=y
CONFIG_SPIRAM_SPEED_80M=y
CONFIG_SPIRAM_USE_MALLOC=y
CONFIG_SPIRAM_MALLOC_ALWAYS_INTERNAL=16384
CONFIG_SPIRAM_MALLOC_RESERVE_INTERNAL=32768
CONFIG_SPIRAM_TRY_ALLOCATE_WIFI_BUFFER_IN_SPIRAM=y

# USB console (USB-JTAG / USB-OTG)
CONFIG_ESP32S3_USB_OTG=y
CONFIG_ESP_CONSOLE_USB_CDC=y

# Partition table (custom for OTA support)
CONFIG_PARTITION_TABLE_CUSTOM=y
CONFIG_PARTITION_TABLE_CUSTOM_FILENAME="partitions.csv"

# FreeRTOS
CONFIG_FREERTOS_HZ=1000
CONFIG_FREERTOS_UNICORE_DISABLE=y
CONFIG_FREERTOS_VTASKLIST_INCLUDE_READY_TASKS=y

# Watchdog
CONFIG_ESP_TASK_WDT_PANIC=y
CONFIG_ESP_TASK_WDT_TIMEOUT_S=5
CONFIG_ESP_TASK_WDT_CHECK_IDLE_TASK_CPU0=y
CONFIG_ESP_TASK_WDT_CHECK_IDLE_TASK_CPU1=y

# WiFi
CONFIG_ESP32S3_DEFAULT_WIFI_ENABLE=y

# Bluetooth (disabled for now, saves memory)
CONFIG_BT_ENABLED=n

# Log level
CONFIG_LOG_DEFAULT_LEVEL_INFO=y
CONFIG_LOG_MAXIMUM_LEVEL_DEBUG=y

# Heap
CONFIG_HEAP_POISONING_COMPREHENSIVE=y
CONFIG_HEAP_TRACING=y
CONFIG_HEAP_TASK_TRACKING=y
```
